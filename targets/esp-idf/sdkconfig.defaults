## targets/esp-idf/sdkconfig.defaults
```kconfig
CONFIG_BOOTLOADER_LOG_LEVEL_WARN=y
CONFIG_LOG_DEFAULT_LEVEL_WARN=y
CONFIG_ESP_MAIN_TASK_STACK_SIZE=24576
CONFIG_PARTITION_TABLE_SINGLE_APP=n
CONFIG_PARTITION_TABLE_SINGLE_APP_LARGE=n
CONFIG_PARTITION_TABLE_CUSTOM=y
CONFIG_PARTITION_TABLE_CUSTOM_FILENAME="partitions.csv"
CONFIG_PARTITION_TABLE_FILENAME="partitions.csv"
CONFIG_ESPTOOLPY_FLASHSIZE_4MB=y
CONFIG_ESPTOOLPY_FLASHSIZE="4MB"
CONFIG_COMPILER_OPTIMIZATION_PERF=y
CONFIG_APP_REPRODUCIBLE_BUILD=y

# Frothy's interruptible millisecond sleep advances in 1 ms slices. ESP-IDF's
# 100 Hz default rounds each slice down to zero ticks, starving the idle task.
CONFIG_FREERTOS_HZ=1000
```
